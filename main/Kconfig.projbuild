## main/Kconfig.projbuild
```kconfig
menu "Nuki Matter Bridge"

    config NUKI_WIFI_SSID
        string "Wi-Fi SSID"
        default ""
        help
            Wi-Fi network to join on first boot. BLE belongs to the Nuki link, so
            Matter commissioning happens on-network (DNS-SD) and the bridge must
            already be on your Wi-Fi. Credentials can also be set at runtime from
            the serial console: "matter esp wifi connect <ssid> <password>".

    config NUKI_WIFI_PASSWORD
        string "Wi-Fi password"
        default ""

    config NUKI_DEVICE_NAME
        string "Name shown in the Nuki app for this bridge"
        default "NukiMatter"

    config NUKI_DEVICE_ID
        int "Bridge device id presented to the lock during pairing"
        default 2020002

    config NUKI_APP_ID
        int "Nuki app id used in lock actions (shows up in the lock's activity log)"
        default 1

    config NUKI_ENABLE_UNBOLT
        bool "Expose the Matter 'Unbolting' feature"
        default n
        help
            Off (default):  Matter Unlock -> Nuki Unlock. The door is never opened (unlatched)
                            from Matter.
            On:             Matter Unbolt -> Nuki Unlock, Matter Unlock -> Nuki Unlatch
                            (opens the door). This is the Matter 1.3+ meaning of
                            "Unlock" for locks that support unbolting. Apple Home has no
                            separate unlatch action: its Unlock then opens the door.
                            Prefer NUKI_OPEN_ENDPOINT.

    config NUKI_OPEN_ENDPOINT
        bool "Add a second lock endpoint that opens the door"
        default y
        depends on !NUKI_ENABLE_UNBOLT
        help
            Adds a second Door Lock endpoint ("Open"). Unlocking it unlatches the
            Nuki (opens the door); it then reports Locked again after a few seconds.
            Being a lock, controllers ask for authentication (Face ID/passcode)
            like for the main lock. See docs/open-door-control.md.

    config NUKI_MATTER_BRIDGE_LABEL
        string "Name of the bridge in Matter controllers"
        default "Nuki Bridge"
        help
            Basic Information NodeLabel of the bridge (max. 32 characters).

    config NUKI_MATTER_LOCK_LABEL
        string "Name of the lock in Matter controllers"
        default "Front door"
        help
            NodeLabel of the bridged lock; Apple Home uses it as the accessory name
            (max. 32 characters). Can still be renamed in the controller.

    config NUKI_MATTER_OPEN_LABEL
        string "Name of the 'Open' lock in Matter controllers"
        default "Door opener"
        depends on NUKI_OPEN_ENDPOINT
        help
            NodeLabel of the unlatch lock (max. 32 characters). Keep it clearly
            different from the lock's name so Siri doesn't confuse the two.

    config NUKI_DOOR_SENSOR
        bool "Expose the Nuki door sensor (Matter DoorState)"
        default n
        help
            Enable if your lock has the Nuki door sensor installed and calibrated.

    config NUKI_STATE_POLL_INTERVAL_S
        int "Fallback lock state poll interval (seconds)"
        default 600
        help
            The lock advertises a beacon when its state changes and the bridge reads
            the state right away. This poll is only a safety net and also refreshes
            the battery level.

    config NUKI_OTA_PASSWORD
        string "Password for firmware updates over Wi-Fi"
        default ""
        help
            Required by POST /api/ota (header X-OTA-Password). Empty disables OTA
            uploads. `make ota` reads it from the build's sdkconfig, so it never
            has to be typed. Sent in clear text over HTTP: LAN only.

    config NUKI_RESET_GPIO
        int "GPIO of a button for unpair/factory reset (-1 = disabled)"
        default 0
        help
            Hold for 10 s: unpair from the Nuki lock and factory-reset Matter.
            GPIO0 is the BOOT button on most dev boards.

    config NUKI_SIMULATE
        bool "Simulate the Nuki lock (no BLE)"
        default n
        help
            Replaces the BLE link with a simulated lock so the Matter side can be
            commissioned and tested without a Nuki in range. Lock/unlock take ~1.5 s,
            and the battery drains 1 % per command. For development only.

endmenu
```
